## Kconfig.projbuild
```kconfig
menu "Network Manager Configuration"

    config NET_MANAGER_WIFI_STA_ENABLED_DEFAULT
        bool "Enable Wi-Fi Station (STA) by default"
        default y
        help
            If selected, the Wi-Fi Station interface will be enabled by default when net_manager_start(NULL) is called.

    config NET_MANAGER_WIFI_AP_ENABLED_DEFAULT
        bool "Enable Wi-Fi Access Point (AP) by default"
        default n
        help
            If selected, the Wi-Fi Access Point interface will be enabled by default for provisioning or other uses.

    config NET_MANAGER_ETHERNET_ENABLED_DEFAULT
        bool "Enable Ethernet by default"
        default n
        help
            If selected, the Ethernet interface will be enabled by default.
            NOTE: You must configure Ethernet PHY and GPIO settings under
            'Component config -> Ethernet'.

    if NET_MANAGER_WIFI_STA_ENABLED_DEFAULT
        config NET_MANAGER_WIFI_STA_SSID_DEFAULT
            string "Default Wi-Fi STA SSID"
            default "Your-SSID"
            help
                Default Wi-Fi SSID for Station mode.

        config NET_MANAGER_WIFI_STA_PASSWORD_DEFAULT
            string "Default Wi-Fi STA Password"
            default "Your-Password"
            help
                Default Wi-Fi Password for Station mode.
    endif

    if NET_MANAGER_WIFI_AP_ENABLED_DEFAULT
        config NET_MANAGER_WIFI_AP_SSID_DEFAULT
            string "Default Wi-Fi AP SSID"
            default "ESP32-Provision-AP"
            help
                Default Wi-Fi SSID for Access Point mode.

        config NET_MANAGER_WIFI_AP_PASSWORD_DEFAULT
            string "Default Wi-Fi AP Password"
            default "12345678"
            help
                Default Wi-Fi Password for Access Point mode. Must be 8-63 characters.

        config NET_MANAGER_WIFI_AP_CHANNEL_DEFAULT
            int "Default Wi-Fi AP Channel"
            default 1
            range 1 13
            help
                Default Wi-Fi channel for Access Point mode.

        config NET_MANAGER_WIFI_AP_MAX_CONN_DEFAULT
            int "Default Wi-Fi AP Max Connections"
            default 4
            range 1 10
            help
                Maximum number of clients that can connect to the AP.
    endif

    config NET_MANAGER_STA_RECONNECT_ATTEMPTS
        int "Wi-Fi STA Reconnect Attempts"
        default 10
        help
            Number of times to attempt reconnection after a disconnect. Set to -1 for infinite attempts.

    config NET_MANAGER_CONNECT_TIMEOUT_MS
        int "Connection Timeout (ms)"
        default 15000
        help
            Timeout in milliseconds for a connection attempt (Wi-Fi STA or Ethernet).

endmenu
```

## example/main/Kconfig.projbuild
```kconfig
menu "Example Configuration"

    help
        Configure the network interfaces to be enabled in this example.
        You can enable Wi-Fi STA, Wi-Fi AP, and Ethernet individually or in any combination.

    # --- Wi-Fi Station Configuration ---
    config EXAMPLE_WIFI_STA_ENABLED
        bool "Enable Wi-Fi Station (STA)"
        default y

    if EXAMPLE_WIFI_STA_ENABLED
        config EXAMPLE_WIFI_SSID
            string "Wi-Fi SSID"
            default "Your-SSID"
        
        config EXAMPLE_WIFI_PASSWORD
            string "Wi-Fi Password"
            default "Your-Password"

        config EXAMPLE_WIFI_STA_USE_STATIC_IP
            bool "Use Static IP for Wi-Fi STA"
            default n
            help
                Enable to test static IP configuration for the Wi-Fi STA interface.

        if EXAMPLE_WIFI_STA_USE_STATIC_IP
            config EXAMPLE_WIFI_STA_STATIC_IP_ADDR
                string "Wi-Fi STA Static IP Address"
                default "192.168.1.150"

            config EXAMPLE_WIFI_STA_STATIC_NETMASK
                string "Wi-Fi STA Static IP Netmask"
                default "255.255.255.0"

            config EXAMPLE_WIFI_STA_STATIC_GATEWAY
                string "Wi-Fi STA Static IP Gateway"
                default "192.168.1.1"

            config EXAMPLE_WIFI_STA_STATIC_DNS_MAIN
                string "Wi-Fi STA Main DNS Server"
                default "8.8.8.8"

            config EXAMPLE_WIFI_STA_STATIC_DNS_BACKUP
                string "Wi-Fi STA Backup DNS Server"
                default "1.1.1.1"
        endif
    endif

    # --- Wi-Fi Access Point Configuration ---
    config EXAMPLE_WIFI_AP_ENABLED
        bool "Enable Wi-Fi Access Point (AP)"
        default n

    if EXAMPLE_WIFI_AP_ENABLED
        config EXAMPLE_AP_SSID
            string "AP SSID"
            default "ESP-Provision-AP"
        
        config EXAMPLE_AP_PASSWORD
            string "AP Password (8+ chars)"
            default "12345678"
    endif

    # --- Ethernet Configuration ---
    config EXAMPLE_ETHERNET_ENABLED
        bool "Enable Ethernet"
        default n
        help
            Remember to configure PHY settings under 'Component config -> Ethernet'.

    if EXAMPLE_ETHERNET_ENABLED
        config EXAMPLE_ETHERNET_USE_STATIC_IP
            bool "Use Static IP for Ethernet"
            default n
            help
                Enable to test static IP configuration for the Ethernet interface.

        if EXAMPLE_ETHERNET_USE_STATIC_IP
            config EXAMPLE_ETHERNET_STATIC_IP_ADDR
                string "Ethernet Static IP Address"
                default "192.168.1.151" # 注意：默认值与Wi-Fi不同

            config EXAMPLE_ETHERNET_STATIC_NETMASK
                string "Ethernet Static IP Netmask"
                default "255.255.255.0"

            config EXAMPLE_ETHERNET_STATIC_GATEWAY
                string "Ethernet Static IP Gateway"
                default "192.168.1.1"

            config EXAMPLE_ETHERNET_STATIC_DNS_MAIN
                string "Ethernet Main DNS Server"
                default "8.8.8.8"

            config EXAMPLE_ETHERNET_STATIC_DNS_BACKUP
                string "Ethernet Backup DNS Server"
                default "1.1.1.1"
        endif
    endif

endmenu
```

## example/main/Kconfig.projbuild_bak
```kconfig
menu "Example Configuration"

    choice EXAMPLE_NET_MODE
        prompt "Network Manager Example Mode"
        default EXAMPLE_MODE_WIFI_STA
        help
            Select the network mode to demonstrate.

        config EXAMPLE_MODE_WIFI_STA
            bool "Wi-Fi Station Example"
            help
                Connects to a Wi-Fi network as a client.

        config EXAMPLE_MODE_ETHERNET
            bool "Ethernet Example"
            help
                Connects to a wired Ethernet network.

        config EXAMPLE_MODE_AP_STA
            bool "Wi-Fi AP+STA Provisioning Example"
            help
                Starts an Access Point and simultaneously tries to connect to a Wi-Fi network.
    
    endchoice

    if EXAMPLE_MODE_WIFI_STA || EXAMPLE_MODE_AP_STA
        config EXAMPLE_WIFI_SSID
            string "Wi-Fi SSID"
            default "Your-SSID"
        
        config EXAMPLE_WIFI_PASSWORD
            string "Wi-Fi Password"
            default "Your-Password"
    endif

    if EXAMPLE_MODE_WIFI_STA || EXAMPLE_MODE_ETHERNET
        config EXAMPLE_USE_STATIC_IP
            bool "Use Static IP"
            default n
            help
                Enable to test static IP configuration instead of DHCP.

        if EXAMPLE_USE_STATIC_IP
            config EXAMPLE_STATIC_IP_ADDR
                string "Static IP Address"
                default "192.168.1.150"

            config EXAMPLE_STATIC_IP_NETMASK
                string "Static IP Netmask"
                default "255.255.255.0"

            config EXAMPLE_STATIC_IP_GATEWAY
                string "Static IP Gateway"
                default "192.168.1.1"

            config EXAMPLE_STATIC_DNS_MAIN
                string "Main DNS Server"
                default "8.8.8.8"
                help
                    Primary DNS server address. Leave empty to not set.

            config EXAMPLE_STATIC_DNS_BACKUP
                string "Backup DNS Server"
                default "1.1.1.1"
                help
                    Secondary DNS server address. Leave empty to not set.
        endif
    endif

endmenu
```
